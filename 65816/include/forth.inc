.importzp SP
.importzp IP
.import PUSH_DS
.import PULL_DS
.import DOCOL
.import FORTH_WORD_DOSEMICOL
.import FORTH_WORD_LIT
.import FORTH_WORD_EXECUTE
.import FORTH_WORD_EXCL
.import FORTH_WORD_AT
.import FORTH_WORD_CEXCL
.import FORTH_WORD_CAT
.import FORTH_WORD_RGT
.import FORTH_WORD_R
.import FORTH_WORD_GTR
.import FORTH_WORD_PLUS
.import FORTH_WORD_2MUL
.import FORTH_WORD_DROP
.import FORTH_WORD_DUP
.import FORTH_WORD_SWAP
.import FORTH_WORD_OVER
.import FORTH_WORD_ROT
.import FORTH_WORD_NOT
.import FORTH_WORD_OR
.import FORTH_WORD_AND
.import FORTH_WORD_XOR
.import LAST_WORD
.import FORTH_WORD_0EQ
.import FORTH_WORD_BRANCH
.import FORTH_WORD_0BRANCH
.import FORTH_WORD_O_PARFINDC_PAR
.import FORTH_WORD_O_PARLOOPC_PAR
.import FORTH_WORD_LEAVE
.import FORTH_WORD_I
.import FORTH_WORD_O_PARDOC_PAR
.import DOCON
.import DOVAR
.import FORTH_WORD_CMOVE
.import FORTH_WORD_PLUSEXCL
.import FORTH_WORD_EQ
.import FORTH_WORD_LT
.import FORTH_WORD_MINUS_OP
.import FORTH_WORD_2DROP
.import FORTH_WORD_2DUP
.import FORTH_WORD_ENCLOSE
.import FORTH_WORD_MDIVMOD
.import FORTH_WORD_UMUL
