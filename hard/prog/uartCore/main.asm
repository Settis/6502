RAM = 0
    
    INCDIR "../std"
    INCLUDE "std.asm"
    if RAM
    INCLUDE "in_ram.asm"
    else
    ORG $FE00
    endif


INTERRUPT_INDIRECT = $FE ; $ $FF
UART_ADDR_LOW = $FC
UART_ADDR_HIGH = $FD
UART_DATA_LENGTH = $FB
UART_HANDLER_WORD = $F9 ; & $FA
UART_CRC = $F8


UART_PING_COMMAND = 1
UART_WRITE_COMMAND = 2
UART_READ_COMMAND = 3
UART_RUN_COMMAND = 4

IRQ_REDIRECT:
    JMP (INTERRUPT_INDIRECT)

IRQ_HANDLER:
    subroutine
    LDA UART_STATUS_REG
    ; skip checking
    LDA UART_DATA_REG
    JMP (UART_HANDLER_WORD)

READ_UART_COMMAND:
    subroutine
    CMP #UART_PING_COMMAND
    BNE .check_write_command
    WRITE_WORD READ_PING_DATA, UART_HANDLER_WORD
    RTI
.check_write_command
    CMP #UART_WRITE_COMMAND
    BNE .check_read_command
    WRITE_WORD READ_WRITE_OFFSET_LOW, UART_HANDLER_WORD
    RTI
.check_read_command
    CMP #UART_READ_COMMAND
    BNE .check_run_command
    WRITE_WORD READ_READ_OFFSET_LOW, UART_HANDLER_WORD
    RTI
.check_run_command
    CMP #UART_RUN_COMMAND
    BNE .ignore
    WRITE_WORD READ_RUN_SUB_LOW, UART_HANDLER_WORD
.ignore
    RTI

READ_PING_DATA:
    CLC
    ADC #1
    STA UART_DATA_REG
    WRITE_WORD READ_UART_COMMAND, UART_HANDLER_WORD
    RTI

READ_WRITE_OFFSET_LOW:
    STA UART_ADDR_LOW
    WRITE_WORD READ_WRITE_OFFSET_HIGH, UART_HANDLER_WORD
    RTI

READ_WRITE_OFFSET_HIGH:
    STA UART_ADDR_HIGH
    WRITE_WORD READ_WRITE_LENGH, UART_HANDLER_WORD
    RTI

READ_WRITE_LENGH:
    STA UART_DATA_LENGTH
    WRITE_WORD READ_WRITE_DATA, UART_HANDLER_WORD
    LDY #0
    STY UART_CRC
    RTI

READ_WRITE_DATA:
    subroutine
    STA (UART_ADDR_LOW),Y
    JSR CRC_IT
    INY
    CPY UART_DATA_LENGTH
    BNE .end
    WRITE_WORD READ_UART_COMMAND, UART_HANDLER_WORD
    LDA UART_CRC
    STA UART_DATA_REG
.end
    RTI

READ_READ_OFFSET_LOW:
    STA UART_ADDR_LOW
    WRITE_WORD READ_READ_OFFSET_HIGH, UART_HANDLER_WORD
    RTI

READ_READ_OFFSET_HIGH:
    STA UART_ADDR_HIGH
    WRITE_WORD READ_READ_LENGH, UART_HANDLER_WORD
    RTI

READ_READ_LENGH:
    STA UART_DATA_LENGTH
    WRITE_WORD SENDING_DATA, UART_HANDLER_WORD
    LDY #0
    STY UART_CRC
    RTI

SENDING_DATA:
    subroutine
    LDA (UART_ADDR_LOW),Y
    STA UART_DATA_REG
    JSR CRC_IT
    INY
    CPY UART_DATA_LENGTH
    BNE .end
    WRITE_WORD SENDING_DATA_CRC, UART_HANDLER_WORD
.end
    RTI

SENDING_DATA_CRC:
    LDA UART_CRC
    STA UART_DATA_REG
    WRITE_WORD READ_UART_COMMAND, UART_HANDLER_WORD
    RTI

READ_RUN_SUB_LOW:
    STA UART_ADDR_LOW
    WRITE_WORD READ_RUN_SUB_HIGH, UART_HANDLER_WORD
    RTI

READ_RUN_SUB_HIGH:
    STA UART_ADDR_HIGH
    WRITE_WORD READ_UART_COMMAND, UART_HANDLER_WORD
    LDA #>(END_OF_RUN - 1)
    PHA
    LDA #<(END_OF_RUN - 1)
    PHA
    CLI
    JMP (UART_ADDR_LOW) 

END_OF_RUN:
    LDA #UART_RUN_COMMAND
    STA UART_DATA_REG
    RTI

CRC_IT:
    subroutine
    EOR UART_CRC
    LDX #8
.loop
    ASL
    BCC .next
    EOR #$07
.next
    DEX
    BNE .loop
    STA UART_CRC
    RTS

debug_start:
reset_start:

    ; Init stack pointer
    LDX #$FF
	TXS

    ; Set control register
    LDA #UART_CONTROL_DEFAULT
    STA UART_CONTROL_REG

    ; Set command register
    LDA #UART_COMMAND_PARITY_MOD_ENABLED | UART_COMMAND_RECEIVER_EVEN_PARITY_CHECKED | UART_COMMAND_TRANSMIT_INTERRUPT_DISABLED | UART_COMMAND_DATA_TERMINAL_READY
    STA UART_COMMAND_REG

    ; Init UART handler
    WRITE_WORD READ_UART_COMMAND, UART_HANDLER_WORD

    ; Set proper redirect for interrupt
    WRITE_WORD IRQ_HANDLER, INTERRUPT_INDIRECT

    CLI

loop:
    jmp loop

    if RAM == 0
    RESET_VECTOR reset_start, IRQ_REDIRECT, IRQ_REDIRECT
    endif
